			  <option value="EU"  >EU868 Europe 		868Mhz (863~870) </option>
			  <option value="CN"  >CN470 China 			470MHz (470~510) </option>
			  <option value="US"  >US915 United States  915Mhz (902~928) </option>
			  <option value="AU"  >AU915 Australia 		915Mhz (915~928) </option>
			  <option value="IN"  >IN865 India 			865MHz (865~867) </option>
			  <option value="KR"  >KR920 Korea 			920MHz (920~923) </option>
			  <option value="AS1" >AS923-1 Asia 		923MHz (920~923),TTN AS1</option>
			  <option value="AS1_2" >AS923-1 Asia 		923MHz (923~925),TTN AS2,Helium AS1</option>
			  <option value="AS2" >AS923-2 Asia			923MHz (921.4-922.8),Helium AS2 </option>
			  <option value="AS3" >AS923-3 Asia 		923MHz (916.6-918.2),Helium AS3 </option>
			  <option value="AS4" >AS923-4 Asia 		923MHz (917.3-918.7),Helium AS4,Israel </option>
			  <option value="RU"  >RU864 Russia 		864MHz (864~870) </option>
			  <option value="MA"  >MA869 Morocco 		869MHz(869.1-870.3) </option>
			  <option value="KZ"  >KZ865 Kazakhstan 	869MHz (865.1-865.9) </option>