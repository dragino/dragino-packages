				<option value="router.eu.thethings.network" >TTN-router-EU, EU 433 and EU 863-870</option>
				<option value="router.us.thethings.network" >TTN-router-US, US 902-928</option>
				<option value="router.as.thethings.network" >TTN-router-Asia-SE, Southeast Asia 923 MHz</option>
				<option value="router.as1.thethings.network" >TTN-router-Asia-SE1, Southeast Asia 920-923 MHz</option>
				<option value="router.as2.thethings.network" >TTN-router-Asia-SE2, Southeast Asia 923-925 MHz</option>
				<option value="router.cn.thethings.network" >TTN-router-CN, China 470-510 and 779-787</option>
				<option value="router.kr.thethings.network" >TTN-router-KR, Korea 920-923 MHz</option>
				<option value="router.jp.thethings.network" >TTN-router-JP, Japan 923-925 MHz</option>
				<option value="as923.thethings.meshed.com.au" >TTN-router-AU, Australia AS923 </option>
				<option value="au915.thethings.meshed.com.au" >TTN-router-AU, Australia 915-928 MHz</option>
				<option value="router.au.thethings.network" >TTN-router-AU-AU915/AS923-MQTT</option>
				<option value="ttn.opennetworkinfrastructure.org" >TTN-switched-router, EU 433 and EU 863-870</option>


